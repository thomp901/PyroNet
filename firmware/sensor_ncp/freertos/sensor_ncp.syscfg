/*
 * Copyright (c) 2018-2024, Texas Instruments Incorporated
 * All rights reserved.
 *
 * Redistribution and use in source and binary forms, with or without
 * modification, are permitted provided that the following conditions
 * are met:
 *
 * *  Redistributions of source code must retain the above copyright
 *    notice, this list of conditions and the following disclaimer.
 *
 * *  Redistributions in binary form must reproduce the above copyright
 *    notice, this list of conditions and the following disclaimer in the
 *    documentation and/or other materials provided with the distribution.
 *
 * *  Neither the name of Texas Instruments Incorporated nor the names of
 *    its contributors may be used to endorse or promote products derived
 *    from this software without specific prior written permission.
 *
 * THIS SOFTWARE IS PROVIDED BY THE COPYRIGHT HOLDERS AND CONTRIBUTORS "AS IS"
 * AND ANY EXPRESS OR IMPLIED WARRANTIES, INCLUDING, BUT NOT LIMITED TO,
 * THE IMPLIED WARRANTIES OF MERCHANTABILITY AND FITNESS FOR A PARTICULAR
 * PURPOSE ARE DISCLAIMED. IN NO EVENT SHALL THE COPYRIGHT OWNER OR
 * CONTRIBUTORS BE LIABLE FOR ANY DIRECT, INDIRECT, INCIDENTAL, SPECIAL,
 * EXEMPLARY, OR CONSEQUENTIAL DAMAGES (INCLUDING, BUT NOT LIMITED TO,
 * PROCUREMENT OF SUBSTITUTE GOODS OR SERVICES; LOSS OF USE, DATA, OR PROFITS;
 * OR BUSINESS INTERRUPTION) HOWEVER CAUSED AND ON ANY THEORY OF LIABILITY,
 * WHETHER IN CONTRACT, STRICT LIABILITY, OR TORT (INCLUDING NEGLIGENCE OR
 * OTHERWISE) ARISING IN ANY WAY OUT OF THE USE OF THIS SOFTWARE,
 * EVEN IF ADVISED OF THE POSSIBILITY OF SUCH DAMAGE.
 */
// @cliArgs --board /ti/boards/LP_CC1352P7_1 --rtos freertos

/*
 * sensor_ncp.syscfg
 *
 * This project uses the TI LP_CC1352P7_1 board metadata only as a SysConfig
 * device context. Physical pin ownership follows the BDE-MB1352P71 module on
 * the custom carrier board.
 */

/* ======== Device / CCFG ======== */
var CCFG = scripting.addModule("/ti/devices/CCFG");

const ccfgSettings = system.getScript("/ti/common/lprf_ccfg_settings.js").ccfgSettings;
for (var ccfgSetting in ccfgSettings)
{
    CCFG[ccfgSetting] = ccfgSettings[ccfgSetting];
}

/*
 * BDE-MB1352P71 module requirement:
 * Enable XOSC cap-array modification and force a delta of 0x00.
 */
CCFG.xoscCapArray = true;
CCFG.xoscCapArrayDelta = 0x00;

/* ======== RF Design ======== */
var rfDesign = scripting.addModule("ti/devices/radioconfig/rfdesign");
const rfDesignSettings = system.getScript("/ti/common/lprf_rf_design_settings.js").rfDesignSettings;
for (var setting in rfDesignSettings)
{
    rfDesign[setting] = rfDesignSettings[setting];
}

/* ======== ITM / SWO ======== */
var ITM = scripting.addModule("/ti/drivers/ITM");
ITM.baudRate = 3000000;
ITM.swoPin.$assign = "DIO16";

/* ======== Drivers ======== */
var RF = scripting.addModule("/ti/drivers/RF");

var TRNG = scripting.addModule("/ti/drivers/TRNG", {}, false);
var trng = TRNG.addInstance();
trng.$name = "NANOSTACK_TRNG";

var Watchdog = scripting.addModule("/ti/drivers/Watchdog", {}, false);
var watchdog = Watchdog.addInstance();
watchdog.$name = "CONFIG_WATCHDOG_0";

var NVS = scripting.addModule("/ti/drivers/NVS");
var nvsInternal = NVS.addInstance();
nvsInternal.$name = "CONFIG_NVSINTERNAL";
nvsInternal.internalFlash.regionBase = 0xA8000;
nvsInternal.internalFlash.regionSize = 0x4000;

var UART2 = scripting.addModule("/ti/drivers/UART2");
var uart2 = UART2.addInstance();
uart2.$name = "CONFIG_UART2_0";
uart2.uart.txPin.$assign = "DIO_28";
uart2.uart.rxPin.$assign = "DIO_27";
uart2.txPinInstance.$name = "CONFIG_PIN_UART_TX";
uart2.rxPinInstance.$name = "CONFIG_PIN_UART_RX";
uart2.txPinInstance.initialOutputState = "High";

var GPIO = scripting.addModule("/ti/drivers/GPIO");

var gpioRed = GPIO.addInstance();
gpioRed.$name = "CONFIG_GPIO_RLED";
gpioRed.mode = "Output";
gpioRed.gpioPin.$assign = "DIO_6";

var gpioGreen = GPIO.addInstance();
gpioGreen.$name = "CONFIG_GPIO_GLED";
gpioGreen.mode = "Output";
gpioGreen.gpioPin.$assign = "DIO_7";

var gpioBtn1 = GPIO.addInstance();
gpioBtn1.$name = "CONFIG_GPIO_BTN1";
gpioBtn1.mode = "Input";
gpioBtn1.pull = "Pull Up";
gpioBtn1.gpioPin.$assign = "DIO_21";

var gpioBtn2 = GPIO.addInstance();
gpioBtn2.$name = "CONFIG_GPIO_BTN2";
gpioBtn2.mode = "Input";
gpioBtn2.pull = "Pull Up";
gpioBtn2.gpioPin.$assign = "DIO_22";

/* ======== Wi-SUN ======== */
var TI154Stack = scripting.addModule("/ti/ti_wisunfan/ti_wisunfan");
if (rfDesignSettings.rfDesign !== undefined)
{
    TI154Stack.rfDesign = rfDesignSettings.rfDesign;
}

TI154Stack.project = "coapnode";
TI154Stack.mode = "frequencyHopping";
TI154Stack.lockProject = true;
TI154Stack.rxOnIdle = true;
TI154Stack.secureLevel = "macSecure";
TI154Stack.genLibs = "macOnly";

/*
 * Border-router profile:
 *   network_name = PyroNet
 *   domain = NA
 *   chan_plan_id = 1
 *   phy_mode_id = 0x02 (Wi-SUN FAN 1.1, 50 kbps 2-GFSK)
 */
TI154Stack.region = "NA";
TI154Stack.regDomain = "0x01";
TI154Stack.phyModeID = "2";
TI154Stack.ChanPlanID = "1";
TI154Stack.opModeClass = "1";
TI154Stack.opModeID = "1b";
TI154Stack.customPhy = false;
TI154Stack.centerFrequency = 902.2;
TI154Stack.channelSpacing = 200;
TI154Stack.totalChannels = 129;
TI154Stack.fhNetname = "PyroNet";
TI154Stack.panID = 0xFFFF;

/* ======== FreeRTOS ======== */
const FreeRTOS = scripting.addModule("/freertos/FreeRTOS");
FreeRTOS.heapSize = 0x5000;
FreeRTOS.posixThreadStackSize = 0x00000200;
FreeRTOS.idleStackSize = 0x00000180;
FreeRTOS.timerStackSize = 0x00000180;

const POSIX = scripting.addModule("/ti/posix/freertos/Settings");
